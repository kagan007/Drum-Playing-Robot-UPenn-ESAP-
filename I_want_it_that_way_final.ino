#define rightMotorForward 18
#define rightMotorReverse 19
#define leftMotorForward 4
#define leftMotorReverse 5
#include <WiFi.h>
#include <WiFiUdp.h>
WiFiUDP UDPTestServer;

int startNote[160] = {29090900,29697000,30597000,32097000,32997000,33597000,34497000,35397000,36897000,37797000,38397000,39297000,40197000,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197903100,198812200};
int duration[159];

int checkUDP() {
  char packetBuffer[100];
  int cb = UDPTestServer.parsePacket();
  if (cb) {
    int len = UDPTestServer.read(packetBuffer, 100);
    packetBuffer[len] = 0;
    if (packetBuffer[0] == 'T') return 1;
    if (packetBuffer[0] == 'G') return 2;
  }
  return 0;
}

void forward(int motorpin, int power, int Time) {
  analogWrite(motorpin, power);
  delay(Time);
  analogWrite(motorpin, 0);
}

void setup() {
  pinMode(leftMotorForward, OUTPUT);
  pinMode(leftMotorReverse, OUTPUT);
  pinMode(rightMotorForward, OUTPUT);
  pinMode(rightMotorReverse, OUTPUT);
  Serial.begin(115200);
  WiFi.begin("TP-Link_05AF", "47543454");
  WiFi.config(IPAddress(192, 168, 1, 59), IPAddress(192, 168, 1, 1), IPAddress(255, 255, 255, 0));
  if (WiFi.status() != WL_CONNECTED) {
    Serial.println("WiFi connected");
  }
  UDPTestServer.begin(2808);

  for (int i = 0; i < 159; i++){
    duration[i] = startNote[i+1]-startNote[i];
  }
}

void loop() {
  int msg = checkUDP();
  if (msg == 2 ) {
    Serial.println("Play");
    delayMicroseconds(startNote[0]);
    for (int i = 0; i < 160; i++) {
      if (i % 2) {
        forward(rightMotorForward, 255, 80);
        delayMicroseconds(duration[i] - 80000);
      } else {
        forward(leftMotorForward, 255, 70);
        delayMicroseconds(duration[i] - 70000);
      }
     }
   }
   else if (msg == 1){
    Serial.println("Test");
    delay(900);
    forward(rightMotorForward, 255, 100);
   }
}
